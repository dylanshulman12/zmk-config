/ {
    chosen {
        zmk,kscan = &kscan0;
    };

    kscan0: kscan {
        compatible = "zmk,kscan-gpio-direct";
        wakeup-source;

        input-gpios
            = <&gpio0 2 (GPIO_ACTIVE_LOW | GPIO_PULL_UP)>; // Pin 002
    };
};
